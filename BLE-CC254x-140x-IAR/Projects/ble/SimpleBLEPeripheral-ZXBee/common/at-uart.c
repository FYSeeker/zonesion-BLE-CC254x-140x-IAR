/*********************************************************************************************
* 文件：at-uart.c
* 作者：Xuzhy 2018.5.16
* 说明：节点AT指令串口初始化
* 修改：fuyou 增加透传驱动部分
* 注释：
*********************************************************************************************/

/*********************************************************************************************
* 头文件
*********************************************************************************************/
#include <iocc2540.h>
#include <stdio.h>
#include "hal_mcu.h"
#include "at-uart.h"
#include "math.h"
/*********************************************************************************************
* 宏定义
*********************************************************************************************/
#define SUPPOER_DEBUG 1
/*********************************************************************************************
* 函数原型说明
*********************************************************************************************/
static void (*_input)(char ch);

/*********************************************************************************************
* 名称：uart0_init(unsigned char StopBits,unsigned char Parity)
* 功能：串口0初始化
* 参数：无
* 返回：无
* 修改：
* 注释：
****************************************** 
*    CC253O 32M系统时钟波特率参数表      * 
*----------------------------------------* 
*  波特率  UxBAUD         UxGCRM         * 
*  240     59             6              * 
*  4800    59             7              * 
*  9600    59             8              * 
*  14400   216            8              * 
*  19200   59             9              * 
*  28800   216            9              * 
*  38400   59             10             * 
*  57600   216            10             * 
*  76800   59             11             * 
*  115200  216            11             * 
*  23040   216            12             * 
****************************************** 
*********************************************************************************************/
void uart0_init(unsigned char StopBits,unsigned char Parity)
{
  P0SEL |=  0x0C;                                               //初始化UART0端口
  PERCFG&= ~0x01;                                               //选择UART0为可选位置一
  P2DIR &= ~0xC0;                                               //P0优先作为串口0
  
  U0GCR = 10;                  
  U0BAUD = 59;                                                  //波特率设置为38400
  
  U0UCR = 2;
  U0CSR = 0xC0;                                                 //设置为UART模式,而且使能接受器
  URX0IE = 1;                                                   // 使能接收中断
}

/*********************************************************************************************
* 名称：uart1_init
* 功能：串口1初始化
* 参数：
* 返回：
* 修改：
* 注释：
*********************************************************************************************/
void uart1_init(void)
{
  PERCFG |= 0x02; //HAL_UART_PERCFG_BIT;     // Set UART1 I/O location to P1.

  P1SEL  |= 0xc0; //HAL_UART_Px_RX_TX;       // Enable Tx and Rx on P1.
  ADCCFG &= ~0xc0; //~HAL_UART_Px_RX_TX;      // Make sure ADC doesnt use this.
  U1CSR = 0x80; //CSR_MODE;                  // Mode is UART Mode.
  U1UCR = 0x80; //UCR_FLUSH;                 // Flush it.
  
  U1BAUD = 59;//0x3B;                  //波特率设置为38400
  U1GCR = 10;//0x0A;                  
  
  U1UCR |= 2|0;       //设置停止位与奇偶校验
  
  U1CSR = 0xC0;      //设置为UART模式,而且使能接受器
  URX1IE = 1;
}

/*********************************************************************************************
* 名称：uart_send_char()
* 功能：串口发送字节函数
* 参数：无
* 返回：无
* 修改：
* 注释：
*********************************************************************************************/
void uart0_send_char(unsigned char ch)
{
  U0DBUF = ch;                                                  //将要发送的数据填入发送缓存寄存器
  while((U0CSR&0x02) == 0);                                     
  U0CSR &= ~0x02;                                             //发送完成后将数据清零
}


/*********************************************************************************************
* 名称：at_uart_init()
* 功能：节点AT指令串口初始化
* 参数：
* 返回：
* 修改：
* 注释：
*********************************************************************************************/
void at_uart_init(void)
{
#if defined(CC2540_Serial)
    uart0_init(0x00,0x00);
#else
    uart1_init();
#endif
}
/*********************************************************************************************
* 名称：at_uart_write()
* 功能：节点AT指令串口写数据
* 参数：
* 返回：
* 修改：
* 注释：
*********************************************************************************************/
void at_uart_write(char ch)
{
#if defined(CC2540_Serial)
    uart0_send_char(ch);
#else
    U1DBUF = ch;
    while(U1TX_BYTE == 0);
    U1TX_BYTE = 0;
#endif
}
/*********************************************************************************************
* 名称：at_uart_set_input_call()
* 功能：节点AT指令串口读数据
* 参数：
* 返回：
* 修改：
* 注释：
*********************************************************************************************/
void at_uart_set_input_call(void (*c)(char ch))
{
  _input = c;
}
/*********************************************************************************************
* 名称：HAL_ISR_FUNCTION()
* 功能：节点AT指令串口中断处理
* 参数：
* 返回：
* 修改：
* 注释：
*********************************************************************************************/
#if defined(CC2540_Serial)
HAL_ISR_FUNCTION(halUart0TxIsr, URX0_VECTOR)
{
    char ch;
    ch = U0DBUF;
    if (_input != NULL) {
        _input(ch);
    }
}
#else
HAL_ISR_FUNCTION(halUart1TxIsr, URX1_VECTOR)
{
  char ch;
    ch = U1DBUF;
    if (_input != NULL) {
      _input(ch);
    }
}
#endif
/*********************************************************************************************
* 名称：putchar()
* 功能：printf iar 调试接口
* 参数：
* 返回：
* 修改：
* 注释：
*********************************************************************************************/
#if  SUPPOER_DEBUG
__near_func int  putchar(int ch) 
{
  at_uart_write(ch);
  return ch;
}
#endif